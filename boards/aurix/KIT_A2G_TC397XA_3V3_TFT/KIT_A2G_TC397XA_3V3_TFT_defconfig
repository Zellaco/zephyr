## boards/aurix/KIT_A2G_TC397XA_3V3_TFT/KIT_A2G_TC397XA_3V3_TFT_defconfig
```kconfig
#TODO: CONFIG_SYS_CLOCK_HW_CYCLES_PER_SEC must be updated
CONFIG_SYS_CLOCK_HW_CYCLES_PER_SEC=100000000
CONFIG_BOOTLOADER_SRAM_SIZE=192
```

## boards/aurix/KIT_A2G_TC397XA_3V3_TFT/Kconfig.board
```kconfig
config BOARD_KIT_A2G_TC397XA_3V3_TFT
	bool "Infineon devkit (TC397XA)"
	depends on SOC_TC397XA
```

## drivers/timer/Kconfig.aurix
```kconfig
# Copyright (c) 2014-2015 Wind River Systems, Inc.
# Copyright (c) 2016 Cadence Design Systems, Inc.
# Copyright (c) 2019 Intel Corp.
# SPDX-License-Identifier: Apache-2.0

config AURIX_TIMER
	bool "Aurix timer support"
	depends on AURIX
	default y
	select TICKLESS_CAPABLE
	help
	  Enables a system timer driver for Aurix based on the CCOUNT
	  and CCOMPARE special registers.

config AURIX_TIMER_ID
	int "System timer CCOMPAREn register index"
	default 1
	depends on AURIX_TIMER
	help
	  Index of the CCOMPARE register (and associated interrupt)
	  used for the system timer.  
```

## dts/bindings/timer/infineon,aurix-sample-controller.yaml
```yaml
# Copyright (c) 2020, STMicroelectronics
# SPDX-License-Identifier: Apache-2.0

description: Aurix timers

compatible: ""

include: base.yaml

properties:
    label:
      required: false

    reg:
      required: false

    clocks:
      required: false

    interrupts:
      required: false

    st,prescaler:
      type: int
      required: false
      description: |
        Clock prescaler at the input of the timer
        Could be in range [0 .. 0xFFFF] for STM32 General Purpose Timers (CLK/(prescaler+1) )
```

## soc/aurix/TC397XA/Kconfig.defconfig
```kconfig
config SOC
	default "TC397XA"
	
config AURIX_TIMER
	default y
	
config SERIAL_TEST
	default y
```
