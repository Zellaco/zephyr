/dts-v1/;
#include <aurix/TC397XA.dtsi>

/ {
	model = "Aurix-controller";
	compatible = "infineon,aurix-sample-controller";

	chosen {
		zephyr,sram = &sram0;
	};
	
	aurix-sample-controller {
     compatible = "infineon,aurix-sample-controller";
	};
};

